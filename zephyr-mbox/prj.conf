## CMakeLists.txt
```
cmake_minimum_required(VERSION 3.20.0)

find_package(Zephyr REQUIRED HINTS $ENV{ZEPHYR_BASE})

if(CONFIG_INCLUDE_REMOTE_DIR)
set(REMOTE_ZEPHYR_DIR ${CMAKE_CURRENT_BINARY_DIR}/../remote/zephyr)
endif()

if(NOT (CONFIG_BOARD_NRF5340DK_NRF5340_CPUAPP OR
        CONFIG_BOARD_NRF5340BSIM_NRF5340_CPUAPP OR
        CONFIG_BOARD_LPCXPRESSO55S69_LPC55S69_CPU0 OR
        CONFIG_BOARD_MIMXRT1160_EVK_MIMXRT1166_CM7 OR
        CONFIG_BOARD_MIMXRT1170_EVK_MIMXRT1176_CM7 OR
        CONFIG_BOARD_MIMXRT700_EVK_MIMXRT798S_CM33_CPU0 OR
        CONFIG_BOARD_FRDM_MCXN947_MCXN947_CPU0 OR
        CONFIG_BOARD_MCX_N9XX_EVK_MCXN947_CPU0 OR
        CONFIG_BOARD_MIMXRT1180_EVK_MIMXRT1189_CM33 OR
        CONFIG_BOARD_EK_RA8P1_R7KA8P1KFLCAC_CM85
       )
  )
  message("${BOARD} is not supported for this sample")
endif()


project(ipc_service)

if(CONFIG_INCLUDE_REMOTE_DIR)
  target_include_directories(zephyr_interface
    INTERFACE ${REMOTE_ZEPHYR_DIR}/include/public)
endif()

target_sources(app PRIVATE src/main.c)

include(ExternalProject)
```

## Kconfig.sysbuild
```
source "share/sysbuild/Kconfig"

config NET_CORE_BOARD
string
	default "nrf5340dk/nrf5340/cpunet" if $(BOARD) = "nrf5340dk"
	default "nrf5340bsim/nrf5340/cpunet" if $(BOARD) = "nrf5340bsim"
	default "lpcxpresso55s69/lpc55s69/cpu1" if $(BOARD) = "lpcxpresso55s69"
	default "mimxrt1160_evk/mimxrt1166/cm4" if $(BOARD) = "mimxrt1160_evk"
	default "mimxrt1170_evk/mimxrt1176/cm4" if $(BOARD) = "mimxrt1170_evk"
	default "mimxrt1170_evkb/mimxrt1176/cm4" if $(BOARD) = "mimxrt1170_evkb"
	default "mimxrt700_evk/mimxrt798s/cm33_cpu1" if $(BOARD) = "mimxrt700_evk"
	default "frdm_mcxn947/mcxn947/cpu1" if $(BOARD) = "frdm_mcxn947"
	default "mcx_n9xx_evk/mcxn947/cpu1" if $(BOARD) = "mcx_n9xx_evk"
	default "mimxrt1180_evk/mimxrt1189/cm7" if $(BOARD) = "mimxrt1180_evk"
	default "ek_ra8p1/r7ka8p1kflcac/cm33" if $(BOARD) = "ek_ra8p1"
	default "imx943_evk/mimx94398/m33" if "$(BOARD)$(BOARD_QUALIFIERS)" = "imx943_evk/mimx94398/m7_1"
	default "imx943_evk/mimx94398/m33" if "$(BOARD)$(BOARD_QUALIFIERS)" = "imx943_evk/mimx94398/m7_0"
	default "imx943_evk/mimx94398/m7_1" if "$(BOARD)$(BOARD_QUALIFIERS)" = "imx943_evk/mimx94398/m33"
```

## prj.conf
```kconfig
CONFIG_MBOX=y
CONFIG_PRINTK=y
CONFIG_MEM_ATTR=y
```

## frdm_mcxn947_mcxn947_cpu0.overlay
```dts
/ {
	cpu0: mbox-consumer {
		compatible = "vnd,mbox-consumer";
		mboxes = <&mbox 0>, <&mbox 1>;
		mbox-names = "tx", "rx";
	};
};
```

## boards/frdm_mcxn947_mcxn947_cpu0.overlay
```dts
#include <zephyr/dt-bindings/memory-attr/memory-attr.h>
#include <zephyr/dt-bindings/memory-attr/memory-attr-arm.h>

/ {
	cpu0: mbox-consumer {
		compatible = "vnd,mbox-consumer";
		mboxes = <&mbox 0>, <&mbox 1>;
		mbox-names = "tx", "rx";
	};

	reserved-memory {
		#address-cells = <1>;
		#size-cells = <1>;
		zephyr,memory-region = "shared_mem";
		cpu_dma_shared: cpu_shared@20060000 {
			reg = <0x20060000 0x80>;
			zephyr,memory-attr = <(DT_MEM_ARM(ATTR_MPU_RAM_NOCACHE) | DT_MEM_ARM(ATTR_MPU_IO))>;
			label = "SHARED_MEM";
		};
	};
};
```

## src/main.c
```c
#include <zephyr/drivers/mbox.h>
#include <zephyr/kernel.h>
#include <zephyr/devicetree.h>
#include <stdbool.h>

struct mailbox_data {
	const char msg[16];
	uint8_t level;
};

uint8_t* base_adr = DT_REG_ADDR(DT_NODELABEL(cpu_dma_shared));
size_t mem_size = DT_REG_SIZE(DT_NODELABEL(cpu_dma_shared));


const struct mbox_dt_spec mbox_transmit = MBOX_DT_SPEC_GET(DT_NODELABEL(cpu0), tx);
const struct mbox_dt_spec mbox_recieve = MBOX_DT_SPEC_GET(DT_NODELABEL(cpu0), rx);

void rx_callback_func(const struct device* dev, mbox_channel_id_t chanid,
		      void* user_data, void* msg) {
	uint8_t data = *(uint8_t*)msg;
	struct mailbox_data temp_data = *(struct mailbox_data*)base_adr;
	if (temp_data.level == 255) {
		printk("recieved error: %s", temp_data.msg);
		return;
	}
	printk("got --> msg: %s, level: %u\n", temp_data.msg, temp_data.level);
}

int main(void) {
	printk("Hello from cpu0\n");
	printk("base_adr: 0x%X\n", base_adr);
	printk("size: %u\n", mem_size);

	if (mbox_register_callback_dt(&mbox_recieve, rx_callback_func, NULL)) {
		printk("failed to register callback\n");
		return 0;
	}
	if (mbox_set_enabled_dt(&mbox_recieve, true)) {
		printk("faield to enable interrupts callbacks for the\n");
		return 0;
	}

	while (1) {
		k_msleep(1000);
		int code = mbox_send_dt(&mbox_transmit, NULL);
		if (code < 0) {
			printk("cpu 0: error code: %d\n", code);
		}
	}
	return 0;
}
```
