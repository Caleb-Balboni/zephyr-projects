## CMakeLists.txt
```
cmake_minimum_required(VERSION 3.20.0)
find_package(Zephyr REQUIRED HINTS $ENV{ZEPHYR_BASE})

project(ipc_service_remote)

target_sources(app PRIVATE src/main.c)
```

## prj.conf
```kconfig
CONFIG_MBOX=y
CONFIG_PRINTK=y
```

## boards/frdm_mcxn947_mcxn947_cpu1.conf
```kconfig
CONFIG_SECOND_CORE_MCUX=y
CONFIG_MEM_ATTR=y
```

## boards/frdm_mcxn947_mcxn947_cpu1.overlay
```dts
#include <zephyr/dt-bindings/memory-attr/memory-attr.h>
/ {
	cpu1: mbox-consumer {
		compatible = "vnd,mbox-consumer";
		mboxes = <&mbox 1>, <&mbox 0>;
		mbox-names = "tx", "rx";
	};

	reserved-memory {
		#address-cells = <1>;
		#size-cells = <1>;
		zephyr,memory-region = "shared_mem";
		cpu_dma_shared: cpu_shared@20060000 {
			reg = <0x20060000 0x80>;
			zephyr,memory-attr = <(DT_MEM_ARM(ATTR_MPU_RAM_NOCACHE) | DT_MEM_ARM(ATTR_MPU_IO))>;
			label = "SHARED_MEM";
		};
	};
};
```

## src/main.c
```c
#include <zephyr/drivers/mbox.h>
#include <string.h>
#include <zephyr/kernel.h>
#include <stdbool.h>

struct mailbox_data {
	const char msg[16];
	uint8_t level;
};

const struct mbox_dt_spec mbox_transmit = MBOX_DT_SPEC_GET(DT_NODELABEL(cpu1), tx);
const struct mbox_dt_spec mbox_recieve = MBOX_DT_SPEC_GET(DT_NODELABEL(cpu1), rx);

size_t mem_size = DT_REG_SIZE(DT_NODELABEL(cpu_dma_shared));
uint32_t* base_adr = DT_REG_ADDR(DT_NODELABEL(cpu_dma_shared));

// the structure we are copying into our shared memory buffer
static struct mailbox_data transmit_data = {
	.msg = "all is well!",
	.level = 0,
};

void rx_callback_func(const struct device* dev, mbox_channel_id_t chanid,
		      void* user_data, void* msg) {
	memcpy(base_adr, &transmit_data, sizeof(struct mailbox_data));
	int code = mbox_send_dt(&mbox_transmit, NULL);
	if (code != 0) {
		printk("failed to send message code: %d\n", code);
	}
	transmit_data.level += 1;
	if (transmit_data.level == 255) {
		transmit_data.level += 1;
	}
}

static void init_mbox_and_memory() {
	memset(base_adr, 0, mem_size);
	if (mbox_register_callback_dt(&mbox_recieve, rx_callback_func, NULL)) {
		strncpy(transmit_data.msg, "error callback", sizeof(transmit_data.msg));
		transmit_data.level = 255;
		mbox_send_dt(&mbox_transmit, NULL);
	}
	if (mbox_set_enabled_dt(&mbox_recieve, true)) {
		strncpy(transmit_data.msg, "error interrupt", sizeof(transmit_data.msg));
		transmit_data.level = 255;
		mbox_send_dt(&mbox_transmit, NULL);
	}
}

int main(void) {

	init_mbox_and_memory();

	while (1) {
		k_msleep(100);
	}
	return 0;
}
```
