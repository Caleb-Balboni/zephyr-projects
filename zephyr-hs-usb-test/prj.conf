## CMakeLists.txt
```
cmake_minimum_required(VERSION 3.20.0)

list(APPEND ZEPHYR_EXTRA_MODULES
  ${CMAKE_CURRENT_SOURCE_DIR}/../../drivers-modules/mcxn-hs-usb
)

find_package(Zephyr REQUIRED HINTS $ENV{ZEPHYR_BASE})
project(my_app)

target_sources(app PRIVATE src/main.c)
```

## prj.conf
```kconfig
CONFIG_HN_HSUSB=y
# Enable the USB device stack
CONFIG_USB_DEVICE_STACK=y

CONFIG_SPEED_OPTIMIZATIONS=y

CONFIG_USB_DEVICE_VID=0xFFFF          
CONFIG_USB_DEVICE_PID=0x4712          
CONFIG_USB_DEVICE_PRODUCT="MCXN_HS_USB" # Product string
CONFIG_USB_DEVICE_MANUFACTURER="CSB"   # Manufacturer string

# Disable other USB classes so only yours registers
CONFIG_USB_CDC_ACM=n
CONFIG_USB_DEVICE_HID=n
CONFIG_USB_DEVICE_BLUETOOTH=n

# Buffer size must accommodate your largest packet
CONFIG_USB_REQUEST_BUFFER_SIZE=512

CONFIG_SYSTEM_WORKQUEUE_STACK_SIZE=2048
```

## src/main.c
```c
#include <zephyr/kernel.h>
#include <hs-usb.h>

void rx_user_callback(const void* data, size_t len) {
  const uint8_t* bytes = (const uint8_t*)data;
  printk("recieved %d bytes: \n", len);
  for (int i = 0; i < len; i++) {
    printk("0x%X ", bytes[i]);
    if ((i + 1) % 32 == 0) {
      printk("\n");
    } 
  }
}

uint8_t data[512];

int main(void) {
  memset(data, 0xFF, sizeof(data));
  int ret = hs_usb_init(K_FOREVER, rx_user_callback);
  if (!ret) {
    printk("init was a success!\n");
  }
  while (1) {
    //hs_usb_send(data, sizeof(data), K_FOREVER);
    k_msleep(1000);
  }
}
```
