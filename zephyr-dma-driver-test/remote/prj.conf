## CMakeLists.txt
```
cmake_minimum_required(VERSION 3.20.0)
find_package(Zephyr REQUIRED HINTS $ENV{ZEPHYR_BASE})

project(dma-core-test-remote)

target_sources(app PRIVATE src/main.c)
```

## prj.conf
```kconfig
CONFIG_MBOX=y
CONFIG_HN_COREDMA=y
CONFIG_PRINTK=y
CONFIG_MEM_ATTR=y
CONFIG_SECOND_CORE_MCUX=y
CONFIG_HEAP_MEM_POOL_SIZE=1024
```

## app.overlay
```dts
#include <zephyr/dt-bindings/memory-attr/memory-attr.h>
#include <zephyr/dt-bindings/memory-attr/memory-attr-arm.h>

/ {
	reserved-memory {
		#address-cells = <1>;
		#size-cells = <1>;
		ranges;

		shared_mem: memory@20060000 {
			reg = <0x20060000 0x400>;
			zephyr,memory-attr =
				<(DT_MEM_ARM(ATTR_MPU_RAM_NOCACHE) | DT_MEM_ARM(ATTR_MPU_IO))>;
			label = "SHARED_MEM";
		};
	};

	coredma1: coredma {
		compatible = "hn,coredma";
		memory-region = <&shared_mem>;
    chan-amt = <1>;
    chan-size = <256>;
	};
};
```

## src/main.c
```c
#include <dma-library/core-dma.h>
#include <zephyr/device.h>

const struct device* dev = DEVICE_DT_GET(DT_NODELABEL(coredma1));

int main(void) {
	int code = dma_core_init(dev, 0);
  uint8_t data[32] = "hello master!";
  dma_core_send(dev, data, sizeof(data));
  while (1) { k_msleep(1000); }
	return 0;
}
```
