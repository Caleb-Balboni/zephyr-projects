## CMakeLists.txt
```
cmake_minimum_required(VERSION 3.20.0)
find_package(Zephyr REQUIRED HINTS $ENV{ZEPHYR_BASE})
project(i2c-ex)

target_include_directories(app PRIVATE src)
target_sources(app PRIVATE src/main.c)
```

## prj.conf
```kconfig
CONFIG_WATCHDOG=y
CONFIG_WDT_MCUX_WWDT_WARNING_INTERRUPT_CFG=1
```

## src/main.c
```c
#include <zephyr/device.h>
#include <zephyr/drivers/watchdog.h>
#include <zephyr/devicetree.h>
#include <zephyr/kernel.h>
#include "watchdog-util.h"

const struct device* watchdog_dev = DEVICE_DT_GET(DT_ALIAS(watchdog0));

// if configuring the watchdog timer as an interrupt we can use a callback with this format
void watchdog_timeout_cb(const struct device* dev, int channel_id) {
	printk("watchdog on chan %d timed out\n", channel_id);
	return;
}

int main(void) {
	if (!device_is_ready(watchdog_dev)) {
		printk("watchdog was not ready\n");
		return 0;
	}
	struct wdt_timeout_cfg timeout_cfg;
	// sets up the watchdog see def in watchdog-util.h
	// VERY IMPORTANT the wdt_install_timeout function MUST be called before the wdt_setup
	// function
	int chan = setup_watchdog(watchdog_dev, &timeout_cfg, 256, 2000, watchdog_timeout_cb, WDT_FLAG_RESET_SOC);
	while (1) {
		// min timout for the watchdog on this board is 255ms so we wait slightly longer to
		// stay in the window
		k_msleep(500);
		wdt_feed(watchdog_dev, chan);
	}
	return 0;
}
```

## src/watchdog-util.h
```c
#include <zephyr/device.h>
#include <zephyr/drivers/watchdog.h>
#include <zephyr/devicetree.h>
#include <zephyr/kernel.h>

// sets up the watchdog timer cfg, and begins the watchdog
// @param dev - the watchdog timer device
// @param cfg - the config to setup
// @param w_begin - the beginning time of the window (ms)
// @param w_end - the end time of the window (ms)
// @param cb - the callback function after a callback (can be NULL if unneeded)
// @param flags - how the watchdog should react after a timeout occurs
// Helpful flags:
//	WDT_FLAG_RESET_NONE	- no reset will happen upon timeout
//	WDT_FLAG_RESET_CPU_CORE - resets the core upon timeout
//	WDT_FLAG_RESET_SOC	- resets the entire board upon timeout
// @return - the channel this timeout configuration will be active on in the watchdog, else -1
int setup_watchdog(const struct device* dev, struct wdt_timeout_cfg* cfg, uint32_t w_begin, uint32_t w_end, wdt_callback_t cb, uint8_t flags) {
	struct wdt_window window = { .min = w_begin, .max = w_end };
	cfg->window = window;
	cfg->callback = cb;
	cfg->flags = flags;
	int ret = wdt_install_timeout(dev, cfg);
	if (wdt_setup(dev, WDT_OPT_PAUSE_IN_SLEEP)) {
		return -1;
	}
	return ret;
}
```
