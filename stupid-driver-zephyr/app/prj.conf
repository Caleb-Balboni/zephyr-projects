## CMakeLists.txt
```
cmake_minimum_required(VERSION 3.20.0)

set(ZEPHYR_EXTRA_MODULES "${CMAKE_SOURCE_DIR}/../hello_world")
find_package(Zephyr REQUIRED HINTS $ENV{ZEPHYR_BASE})
project(fuck)
target_sources(app PRIVATE src/main.c)
```

## prj.conf
```kconfig
CONFIG_HELLO_WORLD=y
```

## app.overlay
```dts
/ {
	aliases {
		hello-world = &hello_world1;
	};

	custom-hello {
		hello_world1: custom-hello1 {
			compatible = "hello,world";
		};
	};
};
```

## src/main.c
```c
#include <stdio.h>
#include <zephyr/kernel.h>
#include "hello_world.h"

static const struct device* dev = DEVICE_DT_GET(DT_ALIAS(hello_world));

int main(void) {

	if (!device_is_ready(dev)) {
		printk("error");
		return 0;
	}
	const struct hello_world_api* hello_api = (const struct hello_world_api*)dev->api;

	hello_api->send(dev);
	return 0;
}
```
