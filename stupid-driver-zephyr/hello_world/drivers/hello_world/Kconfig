## zephyr-driver/app/build/Kconfig/arch/Kconfig.tmp
```kconfig
# Load Zephyr Arch Kconfig descriptions.
osource "/home/calebb/Projects/work-projects/zephyr/zephyr/arch/rx/Kconfig"
osource "/home/calebb/Projects/work-projects/zephyr/zephyr/arch/x86/Kconfig"
osource "/home/calebb/Projects/work-projects/zephyr/zephyr/arch/xtensa/Kconfig"
osource "/home/calebb/Projects/work-projects/zephyr/zephyr/arch/sparc/Kconfig"
osource "/home/calebb/Projects/work-projects/zephyr/zephyr/arch/riscv/Kconfig"
osource "/home/calebb/Projects/work-projects/zephyr/zephyr/arch/posix/Kconfig"
osource "/home/calebb/Projects/work-projects/zephyr/zephyr/arch/mips/Kconfig"
osource "/home/calebb/Projects/work-projects/zephyr/zephyr/arch/arm64/Kconfig"
osource "/home/calebb/Projects/work-projects/zephyr/zephyr/arch/arm/Kconfig"
osource "/home/calebb/Projects/work-projects/zephyr/zephyr/arch/arc/Kconfig"
```

## zephyr-driver/app/build/Kconfig/boards/Kconfig
```kconfig
# Load Zephyr board Kconfig descriptions.
osource "/home/calebb/Projects/work-projects/zephyr/zephyr/boards/nxp/frdm_mcxn947/Kconfig"
```

## zephyr-driver/app/build/Kconfig/soc/Kconfig
```kconfig
# Load Zephyr SoC Kconfig descriptions.
osource "/home/calebb/Projects/work-projects/zephyr/zephyr/soc/xlnx/zynqmp/Kconfig"
osource "/home/calebb/Projects/work-projects/zephyr/zephyr/soc/xlnx/zynq7000/Kconfig"
osource "/home/calebb/Projects/work-projects/zephyr/zephyr/soc/xlnx/versalnet/Kconfig"
osource "/home/calebb/Projects/work-projects/zephyr/zephyr/soc/xlnx/versal2/Kconfig"
osource "/home/calebb/Projects/work-projects/zephyr/zephyr/soc/xlnx/versal/Kconfig"
osource "/home/calebb/Projects/work-projects/zephyr/zephyr/soc/xen/Kconfig"
osource "/home/calebb/Projects/work-projects/zephyr/zephyr/soc/wch/ch32v/Kconfig"
osource "/home/calebb/Projects/work-projects/zephyr/zephyr/soc/ti/simplelink/Kconfig"
osource "/home/calebb/Projects/work-projects/zephyr/zephyr/soc/ti/mspm0/Kconfig"
osource "/home/calebb/Projects/work-projects/zephyr/zephyr/soc/ti/lm3s6965/Kconfig"
osource "/home/calebb/Projects/work-projects/zephyr/zephyr/soc/ti/k3/Kconfig"
osource "/home/calebb/Projects/work-projects/zephyr/zephyr/soc/telink/tlsr/Kconfig"
osource "/home/calebb/Projects/work-projects/zephyr/zephyr/soc/starfive/jh71xx/Kconfig"
osource "/home/calebb/Projects/work-projects/zephyr/zephyr/soc/st/stm32/Kconfig"
osource "/home/calebb/Projects/work-projects/zephyr/zephyr/soc/snps/qemu_arc/Kconfig"
osource "/home/calebb/Projects/work-projects/zephyr/zephyr/soc/snps/nsim/arc_v/Kconfig"
osource "/home/calebb/Projects/work-projects/zephyr/zephyr/soc/snps/nsim/arc_classic/Kconfig"
osource "/home/calebb/Projects/work-projects/zephyr/zephyr/soc/snps/hsdk4xd/Kconfig"
osource "/home/calebb/Projects/work-projects/zephyr/zephyr/soc/snps/hsdk/Kconfig"
osource "/home/calebb/Projects/work-projects/zephyr/zephyr/soc/snps/emsk/Kconfig"
osource "/home/calebb/Projects/work-projects/zephyr/zephyr/soc/snps/emsdp/Kconfig"
osource "/home/calebb/Projects/work-projects/zephyr/zephyr/soc/snps/arc_iot/Kconfig"
osource "/home/calebb/Projects/work-projects/zephyr/zephyr/soc/silabs/Kconfig"
osource "/home/calebb/Projects/work-projects/zephyr/zephyr/soc/sifli/sf32/Kconfig"
osource "/home/calebb/Projects/work-projects/zephyr/zephyr/soc/sifive/sifive_freedom/Kconfig"
osource "/home/calebb/Projects/work-projects/zephyr/zephyr/soc/sensry/Kconfig"
osource "/home/calebb/Projects/work-projects/zephyr/zephyr/soc/rockchip/Kconfig"
osource "/home/calebb/Projects/work-projects/zephyr/zephyr/soc/renode/riscv_virtual/Kconfig"
osource "/home/calebb/Projects/work-projects/zephyr/zephyr/soc/renode/cortex_r8_virtual/Kconfig"
osource "/home/calebb/Projects/work-projects/zephyr/zephyr/soc/renesas/smartbond/Kconfig"
osource "/home/calebb/Projects/work-projects/zephyr/zephyr/soc/renesas/rz/Kconfig"
osource "/home/calebb/Projects/work-projects/zephyr/zephyr/soc/renesas/rx/Kconfig"
osource "/home/calebb/Projects/work-projects/zephyr/zephyr/soc/renesas/rcar/Kconfig"
osource "/home/calebb/Projects/work-projects/zephyr/zephyr/soc/renesas/ra/Kconfig"
osource "/home/calebb/Projects/work-projects/zephyr/zephyr/soc/realtek/ec/Kconfig"
osource "/home/calebb/Projects/work-projects/zephyr/zephyr/soc/realtek/ameba/Kconfig"
osource "/home/calebb/Projects/work-projects/zephyr/zephyr/soc/raspberrypi/rpi_pico/Kconfig"
osource "/home/calebb/Projects/work-projects/zephyr/zephyr/soc/quicklogic/eos_s3/Kconfig"
osource "/home/calebb/Projects/work-projects/zephyr/zephyr/soc/qemu/virt_riscv/Kconfig"
osource "/home/calebb/Projects/work-projects/zephyr/zephyr/soc/qemu/malta/Kconfig"
osource "/home/calebb/Projects/work-projects/zephyr/zephyr/soc/openisa/rv32m1/Kconfig"
osource "/home/calebb/Projects/work-projects/zephyr/zephyr/soc/openhwgroup/cva6/Kconfig"
osource "/home/calebb/Projects/work-projects/zephyr/zephyr/soc/oct/osd32mp15x/Kconfig"
osource "/home/calebb/Projects/work-projects/zephyr/zephyr/soc/nxp/s32/Kconfig"
osource "/home/calebb/Projects/work-projects/zephyr/zephyr/soc/nxp/rw/Kconfig"
osource "/home/calebb/Projects/work-projects/zephyr/zephyr/soc/nxp/mcx/Kconfig"
osource "/home/calebb/Projects/work-projects/zephyr/zephyr/soc/nxp/lpc/Kconfig"
osource "/home/calebb/Projects/work-projects/zephyr/zephyr/soc/nxp/layerscape/Kconfig"
osource "/home/calebb/Projects/work-projects/zephyr/zephyr/soc/nxp/kinetis/Kconfig"
osource "/home/calebb/Projects/work-projects/zephyr/zephyr/soc/nxp/imxrt/Kconfig"
osource "/home/calebb/Projects/work-projects/zephyr/zephyr/soc/nxp/imx/Kconfig"
osource "/home/calebb/Projects/work-projects/zephyr/zephyr/soc/nuvoton/numicro/Kconfig"
osource "/home/calebb/Projects/work-projects/zephyr/zephyr/soc/nuvoton/numaker/Kconfig"
osource "/home/calebb/Projects/work-projects/zephyr/zephyr/soc/nuvoton/npcx/Kconfig"
osource "/home/calebb/Projects/work-projects/zephyr/zephyr/soc/nuvoton/npcm/Kconfig"
osource "/home/calebb/Projects/work-projects/zephyr/zephyr/soc/nordic/Kconfig"
osource "/home/calebb/Projects/work-projects/zephyr/zephyr/soc/neorv32/Kconfig"
osource "/home/calebb/Projects/work-projects/zephyr/zephyr/soc/native/inf_clock/Kconfig"
osource "/home/calebb/Projects/work-projects/zephyr/zephyr/soc/microchip/sam/sama7/Kconfig"
osource "/home/calebb/Projects/work-projects/zephyr/zephyr/soc/microchip/sam/sam_d5x_e5x/Kconfig"
osource "/home/calebb/Projects/work-projects/zephyr/zephyr/soc/microchip/pic64/Kconfig"
osource "/home/calebb/Projects/work-projects/zephyr/zephyr/soc/microchip/pic32c/pic32cz_ca/Kconfig"
osource "/home/calebb/Projects/work-projects/zephyr/zephyr/soc/microchip/pic32c/pic32cx_sg/Kconfig"
osource "/home/calebb/Projects/work-projects/zephyr/zephyr/soc/microchip/pic32c/pic32cm_jh/Kconfig"
osource "/home/calebb/Projects/work-projects/zephyr/zephyr/soc/microchip/miv/Kconfig"
osource "/home/calebb/Projects/work-projects/zephyr/zephyr/soc/microchip/mec/Kconfig"
osource "/home/calebb/Projects/work-projects/zephyr/zephyr/soc/mediatek/mt8xxx/Kconfig"
osource "/home/calebb/Projects/work-projects/zephyr/zephyr/soc/lowrisc/opentitan/Kconfig"
osource "/home/calebb/Projects/work-projects/zephyr/zephyr/soc/litex/litex_vexriscv/Kconfig"
osource "/home/calebb/Projects/work-projects/zephyr/zephyr/soc/ite/ec/Kconfig"
osource "/home/calebb/Projects/work-projects/zephyr/zephyr/soc/intel/wildcat_lake/Kconfig"
osource "/home/calebb/Projects/work-projects/zephyr/zephyr/soc/intel/raptor_lake/Kconfig"
osource "/home/calebb/Projects/work-projects/zephyr/zephyr/soc/intel/panther_lake/Kconfig"
osource "/home/calebb/Projects/work-projects/zephyr/zephyr/soc/intel/lakemont/Kconfig"
osource "/home/calebb/Projects/work-projects/zephyr/zephyr/soc/intel/intel_socfpga_std/Kconfig"
osource "/home/calebb/Projects/work-projects/zephyr/zephyr/soc/intel/intel_socfpga/Kconfig"
osource "/home/calebb/Projects/work-projects/zephyr/zephyr/soc/intel/intel_niosv/Kconfig"
osource "/home/calebb/Projects/work-projects/zephyr/zephyr/soc/intel/intel_ish/Kconfig"
osource "/home/calebb/Projects/work-projects/zephyr/zephyr/soc/intel/intel_adsp/Kconfig"
osource "/home/calebb/Projects/work-projects/zephyr/zephyr/soc/intel/elkhart_lake/Kconfig"
osource "/home/calebb/Projects/work-projects/zephyr/zephyr/soc/intel/atom/Kconfig"
osource "/home/calebb/Projects/work-projects/zephyr/zephyr/soc/intel/apollo_lake/Kconfig"
osource "/home/calebb/Projects/work-projects/zephyr/zephyr/soc/intel/alder_lake/Kconfig"
osource "/home/calebb/Projects/work-projects/zephyr/zephyr/soc/infineon/psoc4/Kconfig"
osource "/home/calebb/Projects/work-projects/zephyr/zephyr/soc/infineon/edge/Kconfig"
osource "/home/calebb/Projects/work-projects/zephyr/zephyr/soc/infineon/cat3/Kconfig"
osource "/home/calebb/Projects/work-projects/zephyr/zephyr/soc/infineon/cat1c/Kconfig"
osource "/home/calebb/Projects/work-projects/zephyr/zephyr/soc/infineon/cat1b/Kconfig"
osource "/home/calebb/Projects/work-projects/zephyr/zephyr/soc/infineon/cat1a/Kconfig"
osource "/home/calebb/Projects/work-projects/zephyr/zephyr/soc/gd/gd32/Kconfig"
osource "/home/calebb/Projects/work-projects/zephyr/zephyr/soc/gaisler/leon3/Kconfig"
osource "/home/calebb/Projects/work-projects/zephyr/zephyr/soc/gaisler/gr716a/Kconfig"
osource "/home/calebb/Projects/work-projects/zephyr/zephyr/soc/focaltech/Kconfig"
osource "/home/calebb/Projects/work-projects/zephyr/zephyr/soc/espressif/Kconfig"
osource "/home/calebb/Projects/work-projects/zephyr/zephyr/soc/ene/kb1200/Kconfig"
osource "/home/calebb/Projects/work-projects/zephyr/zephyr/soc/ene/kb106x/Kconfig"
osource "/home/calebb/Projects/work-projects/zephyr/zephyr/soc/elan/em32f967/Kconfig"
osource "/home/calebb/Projects/work-projects/zephyr/zephyr/soc/egis/Kconfig"
osource "/home/calebb/Projects/work-projects/zephyr/zephyr/soc/efinix/sapphire/Kconfig"
osource "/home/calebb/Projects/work-projects/zephyr/zephyr/soc/cdns/xtensa_sample_controller/Kconfig"
osource "/home/calebb/Projects/work-projects/zephyr/zephyr/soc/cdns/sample_controller32/Kconfig"
osource "/home/calebb/Projects/work-projects/zephyr/zephyr/soc/cdns/dc233c/Kconfig"
osource "/home/calebb/Projects/work-projects/zephyr/zephyr/soc/brcm/bcmvk/Kconfig"
osource "/home/calebb/Projects/work-projects/zephyr/zephyr/soc/brcm/bcm2712/Kconfig"
osource "/home/calebb/Projects/work-projects/zephyr/zephyr/soc/brcm/bcm2711/Kconfig"
osource "/home/calebb/Projects/work-projects/zephyr/zephyr/soc/blackberry/qnxhv_vm/Kconfig"
osource "/home/calebb/Projects/work-projects/zephyr/zephyr/soc/bflb/Kconfig"
osource "/home/calebb/Projects/work-projects/zephyr/zephyr/soc/atmel/sam0/Kconfig"
osource "/home/calebb/Projects/work-projects/zephyr/zephyr/soc/atmel/sam/Kconfig"
osource "/home/calebb/Projects/work-projects/zephyr/zephyr/soc/aspeed/Kconfig"
osource "/home/calebb/Projects/work-projects/zephyr/zephyr/soc/arm/Kconfig"
osource "/home/calebb/Projects/work-projects/zephyr/zephyr/soc/arm/beetle/Kconfig"
osource "/home/calebb/Projects/work-projects/zephyr/zephyr/soc/antmicro/myra/Kconfig"
osource "/home/calebb/Projects/work-projects/zephyr/zephyr/soc/andestech/Kconfig"
osource "/home/calebb/Projects/work-projects/zephyr/zephyr/soc/amd/acp_6_0/Kconfig"
osource "/home/calebb/Projects/work-projects/zephyr/zephyr/soc/ambiq/Kconfig"
osource "/home/calebb/Projects/work-projects/zephyr/zephyr/soc/allwinner/sun8i_h3/Kconfig"
osource "/home/calebb/Projects/work-projects/zephyr/zephyr/soc/aesc/Kconfig"
osource "/home/calebb/Projects/work-projects/zephyr/zephyr/soc/adi/max32/Kconfig"
```

## zephyr-logging/fs-logging/Kconfig
```kconfig
config FS_LOG_BACKEND
	bool "file system logging backend"
	default n
	depends on LOG

source 'Kconfig.zephyr'
```

## zephyr-lte-test/build/Kconfig/boards/Kconfig.frdm_mcxn947
```kconfig
# Load board Kconfig descriptions.
osource "/home/bionet-caleb/testing/zephyr-testing/zephyr/boards/nxp/frdm_mcxn947/Kconfig.frdm_mcxn947"
```

## zephyr-mbox/build/remote/Kconfig/boards/Kconfig.sysbuild.tmp
```kconfig
# Load Sysbuild board Kconfig descriptions.
osource "/home/bionet-caleb/testing/zephyr-testing/zephyr/boards/nxp/frdm_mcxn947/Kconfig.sysbuild"
```

## zephyr-rtc/build/Kconfig/boards/Kconfig.defconfig.tmp
```kconfig
# Load Zephyr board defconfig descriptions.
osource "/home/calebb/Projects/work-projects/zephyr/zephyr/boards/nxp/frdm_mcxn947/Kconfig.defconfig"
```

## zephyr-usb/build/Kconfig/boards/Kconfig.defconfig
```kconfig
# Load Zephyr board defconfig descriptions.
osource "/home/bionet-caleb/testing/zephyr-testing/zephyr/boards/nxp/frdm_mcxn947/Kconfig.defconfig"
```
